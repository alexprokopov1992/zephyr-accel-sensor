## Kconfig
```kconfig
# SPDX-License-Identifier: Apache-2.0

config LIS2DW12_ACCEL_SENSOR
	bool "LIS2DW12 Accelerometer Sensor Driver"
	default y
	depends on DT_HAS_FENIX_LIS2DW12_ACCEL_ENABLED
	depends on SPI
	depends on GPIO
	depends on SENSOR
	help
	  Enable driver for STMicroelectronics LIS2DW12 3-axis accelerometer.
	  This driver supports SPI interface and interrupt-driven data acquisition.

if LIS2DW12_ACCEL_SENSOR

config LIS2DW12_ACCEL_SENSOR_INIT_PRIORITY
	int "LIS2DW12 sensor init priority"
	default 70
	help
	  Device driver initialization priority.

endif # LIS2DW12_ACCEL_SENSOR
```

## dts/bindings/sensor/fenix,lis2dw12-accel.yaml
```yaml
# Copyright (c) 2025
# SPDX-License-Identifier: Apache-2.0

description: STMicroelectronics LIS2DW12 3-axis accelerometer sensor

compatible: "fenix,lis2dw12-accel"

include: [sensor-device.yaml, spi-device.yaml]

properties:
  int-gpios:
    type: phandle-array
    required: true
    description: |
      GPIO connected to INT1 pin for data ready interrupt
      
  sampling-period-ms:
    type: int
    default: 1000
    description: |
      Sampling period in milliseconds for periodic measurements
```

## dts/bindings/sensor/zephyr,accel-sensor.yaml
```yaml
description: Zephyr Accelerometer Sensor Driver

compatible: "zephyr,accel-sensor"

properties:
  sampling-period-ms:
    type: int
    default: 20
    description: Sampling period in milliseconds
    
  accel-device:
    type: phandle
    required: true
    description: Reference to the accelerometer device (lis2dw12)
```
